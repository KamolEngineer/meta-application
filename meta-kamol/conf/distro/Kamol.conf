## meta-kamol/conf/distro/Kamol.conf
```bitbake
DISTRO_NAME = "Kamol"
DISTRO_CODENAME = "master"
DISTRO_VERSION = "${DISTRO_CODENAME}-${DISTRO_NAME}"

PACKAGE_CLASSES = "package_rpm"

INIT_MANAGER = "sysvinit"

ENABLE_UART = "1"
LICENSE_FLAGS_ACCEPTED = "synaptics-killswitch"

IMAGE_INSTALL:append = " python3-flask nudoku helloworld nsnake"
RPI_USE_U_BOOT = "1"
```

## meta-kamol/conf/distro/Kulbin.conf
```bitbake
DISTRO = "Kulbin"
DISTRO_NAME = "Kulbin"
DISTRO_VERSION = "1.0"
DISTRO_CODENAME = "master"

LOCALCONF_VERSION = "2"

# Override these in KULBIN based distros
KULBIN_DEFAULT_DISTRO_FEATURES = "opengl ptest multiarch wayland vulkan"
KULBIN_DEFAULT_EXTRA_RDEPENDS = "packagegroup-core-boot packagegroups-console-games"
KULBIN_DEFAULT_EXTRA_RRECOMMENDS = "kernel-module-af-packet"

DISTRO_FEATURES ?= "${DISTRO_FEATURES_DEFAULT} ${KULBIN_DEFAULT_DISTRO_FEATURES}"

SDK_NAME = "${DISTRO}-${TCLIBC}-${SDKMACHINE}-${IMAGE_BASENAME}-${TUNE_PKGARCH}-${MACHINE}"
SDKPATHINSTALL = "/opt/${DISTRO}/${SDK_VERSION}"

DISTRO_EXTRA_RDEPENDS += "${KULBIN_DEFAULT_EXTRA_RDEPENDS}"
DISTRO_EXTRA_RRECOMMENDS += "${KULBIN_DEFAULT_EXTRA_RRECOMMENDS}"

TCLIBCAPPEND = ""

PACKAGE_CLASSES ?= "package_rpm"

require conf/distro/include/no-static-libs.inc
require conf/distro/include/yocto-uninative.inc
require conf/distro/include/security_flags.inc
INHERIT += "uninative"

BB_SIGNATURE_HANDLER ?= "OEEquivHash"
BB_HASHSERVE ??= "auto"

KULBIN_INIT_MANAGER = "systemd"
INIT_MANAGER ?= "${KULBIN_INIT_MANAGER}"

# We need debug symbols so that SPDX license manifests for the kernel work
KERNEL_EXTRA_FEATURES:append = " features/debug/debug-kernel.scc"

# Enable creation of SPDX manifests by default
INHERIT += "create-spdx"

LICENSE_FLAGS_ACCEPTED = "synaptics-killswitch"

IMAGE_INSTALL:append = " python3-flask helloworld iperf3 htop"

ENABLE_UART = "1"
RPI_USE_U_BOOT = "1"

DISTRO_FEATURES:append = " pam"

PARALLEL_MAKE:pn-wpewebkit = "-j 4"

# Webkit setup
MACHINE_FEATURES:append = " vc4graphics"
GPU_MEM_256 = "128"
GPU_MEM_512 = "196"
GPU_MEM_1024 = "396"
DISTRO_FEATURES:append = " opengl egl wayland"
EXTRA_IMAGE_FEATURES = "debug-tweaks"
IMAGE_FEATURES:append = " ssh-server-dropbear hwcodecs"
PREFERRED_PROVIDER_virtual/wpebackend = "wpebackend-fdo"
IMAGE_INSTALL:append = " wpewebkit cog"

IMAGE_INSTALL:append = " libgpiod libgpiod-tools apache2 web-toggle start-script gpio-permissions"
```
